## initramfs/buildroot_rzg2_defconfig
```kconfig
BR2_aarch64=y
BR2_cortex_a57_a53=y
BR2_TOOLCHAIN_EXTERNAL=y
BR2_TOOLCHAIN_EXTERNAL_LINARO_AARCH64=y
BR2_TARGET_GENERIC_GETTY_PORT="ttySC0"
BR2_PACKAGE_DOSFSTOOLS=y
BR2_PACKAGE_DOSFSTOOLS_MKFS_FAT=y
BR2_PACKAGE_E2FSPROGS=y
```
